#include <TinyWireM.h>
#include <TinyOzOLED.h>
#include <TinyBME280.h>

int buttonLastState = 0;
int buttonState = 0;
long elapsedTime = 0;

const byte customLetters [][96] PROGMEM = {
{0x00, 0x00, 0x00, 0x00, 0x00, 0x00, 0x00, 0x00, 0x00, 0x00, 0x00, 0x00, 0x00, 0x00, 0x00, 0x00, 0x00, 0x00, 0x00, 0x00, 0x00, 0x00, 0x00, 0x00,
0x00, 0x00, 0x0E, 0x1F, 0x1F, 0x1F, 0x1F, 0x0E, 0x00, 0x00, 0xFE, 0xFF, 0xFF, 0xFF, 0x1F, 0x0F, 0x0F, 0x0F, 0x0F, 0x0F, 0x0F, 0x0F, 0x1F, 0x1E,
0x00, 0x00, 0x00, 0x00, 0x00, 0x00, 0x00, 0x00, 0x00, 0x00, 0xFF, 0xFF, 0xFF, 0xFF, 0x80, 0x00, 0x00, 0x00, 0x00, 0x00, 0x00, 0x00, 0x80, 0x80,
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0x00, 0x00, 0x00, 0x00, 0x00, 0x00, 0x00, 0x01, 0x07, 0x0F, 0x0F, 0x0F, 0x0F, 0x0F, 0x0F, 0x07, 0x01, 0x00, 0x00, 0x00, 0x00, 0x00, 0x00, 0x00}
};

void setup() {
  BME280setI2Caddress(0x76);
  BME280setup();
  
  OzOled.init();  
  OzOled.printString("");
  
  buttonLastState = 0;
  buttonState = 0;
  pinMode (A3, INPUT_PULLUP);
}

void loop() {
  int newState = 0;
  bool stateChanged = false;
  
  if(millis() < 2000){
    setup();  
    stateChanged = true;
  }
  
  newState = digitalRead(A3);
  
  if(newState == 0 && buttonLastState != 0){
    buttonState = (buttonState + 1) % 3;
    stateChanged = true;
  }

  buttonLastState = newState;
  
  // Mode 1
  //OzOled.printString(String("Temp: " + String(BME280temperature()/100) + "." + String((BME280temperature()%100)/10) + " C").c_str(),0,0);
  //OzOled.printString(String("Humd: " + String(BME280humidity()/100) + "." + String((BME280humidity()%100)/10) + " %").c_str(),0,2);  

  // Mode 2
  if((millis() - elapsedTime) / 1000 > 1 || stateChanged == true){
    elapsedTime = millis();
    
    if(buttonState == 0){
      OzOled.printBigNumber(String(String(BME280temperature()/100) + "." + String((BME280temperature()%100)/10)).c_str(),0,0);
      OzOled.drawBitmap(customLetters[0],12,0,3,4);
    }
    else if(buttonState == 1){
      OzOled.printBigNumber(String(String(BME280humidity()/100) + "." + String((BME280humidity()%100)/10)).c_str(),0,0);
      OzOled.drawBitmap(customLetters[1],12,0,3,4);  
    }
    else if(buttonState == 2){
      ADMUX = _BV(MUX3) | _BV(MUX2); 
      delay(2); // Wait for Vref to settle
      ADCSRA |= _BV(ADSC); // Start conversion
      while (bit_is_set(ADCSRA,ADSC)); // measuring
     
      uint8_t low  = ADCL; // must read ADCL first - it then locks ADCH  
      uint8_t high = ADCH; // unlocks both
     
      long result = (high<<8) | low; 
      result = 1125300L / result;
      
      OzOled.printBigNumber(String(String(result/1000) + "." + String((result%1000)/10)).c_str(),0,0);
      OzOled.drawBitmap(customLetters[2],12,0,3,4);
    }  
  } 

  delay(100);
}
